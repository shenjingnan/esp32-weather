## main/Kconfig.projbuild
```kconfig
menu "Web Server Configuration"
    config ENABLE_WEB_SERVER
        bool "Enable embedded web server"
        default y
        help
            Enable the embedded HTTP server with Preact-based UI.
            Requires frontend to be built (npm build in web/ directory).

    config WEB_SERVER_PORT
        int "Web server port"
        default 80
        range 80 65535
        help
            TCP port for the embedded HTTP server.

    config WEB_MOUNT_POINT
        string "Web files mount point in VFS"
        default "/www"
        help
            VFS path where LittleFS partition (containing web assets) is mounted.

    config MDNS_HOST_NAME
        string "mDNS hostname"
        default "esp32-weather"
        help
            mDNS hostname for accessing the device via http://<hostname>.local
endmenu
```

## sdkconfig.defaults
```kconfig
CONFIG_MBEDTLS_TLS_CLIENT_ONLY=y
CONFIG_PARTITION_TABLE_CUSTOM=y
CONFIG_PARTITION_TABLE_CUSTOM_FILENAME="partitions.csv"
CONFIG_PARTITION_TABLE_FILENAME="partitions.csv"
CONFIG_ENABLE_WEB_SERVER=y
CONFIG_ESPTOOLPY_FLASHSIZE_8MB=y
CONFIG_ESPTOOLPY_FLASHSIZE="8MB"
CONFIG_PARTITION_TABLE_OFFSET=0x8000
CONFIG_LWIP_MAX_SOCKETS=16
CONFIG_MDNS_NETWORKING_SOCKET=y
CONFIG_MDNS_PREDEF_NETIF_AP=n
CONFIG_MDNS_RESPOND_REVERSE_QUERIES=y
```
